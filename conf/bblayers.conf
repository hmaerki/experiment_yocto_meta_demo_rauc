## conf/bblayers.conf
```bitbake
# POKY_BBLAYERS_CONF_VERSION is increased each time build/conf/bblayers.conf
# changes incompatibly
POKY_BBLAYERS_CONF_VERSION = "2"

BBPATH = "${TOPDIR}"
BBFILES ?= ""

BBLAYERS ?= " \
  /workdir/sources/poky/meta \
  /workdir/sources/poky/meta-poky \
  /workdir/meta-demorauc \
  "

# /home/usersetup/poky/meta
# /home/usersetup/poky/meta-poky
# /home/usersetup/poky/meta-yocto-bsp
#   /workdir/meta-demorauc
```

## conf/layer.conf
```bitbake
# We have a conf and classes directory, add to BBPATH
BBPATH .= ":${LAYERDIR}"

# We have recipes-* directories, add to BBFILES
BBFILES += "${LAYERDIR}/recipes-*/*/*.bb \
            ${LAYERDIR}/recipes-*/*/*.bbappend"

BBFILE_COLLECTIONS += "meta-demorauc"
BBFILE_PATTERN_meta-demorauc = "^${LAYERDIR}/"
BBFILE_PRIORITY_meta-demorauc = "6"

LAYERDEPENDS_meta-demorauc = "core"
# LAYERDEPENDS_meta-demorauc = "poky"
LAYERSERIES_COMPAT_meta-demorauc = "kirkstone"
# LAYERSERIES_COMPAT_meta-demorauc = "mickledore"
```
